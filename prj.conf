## CMakeLists.txt
```
cmake_minimum_required(VERSION 3.20.0)

find_package(Zephyr REQUIRED HINTS $ENV{ZEPHYR_BASE})
project(my_zephyr_app)

FILE(GLOB app_sources src/*.c)
target_sources(app PRIVATE ${app_sources})
```

## prj.conf
```kconfig
CONFIG_GPIO=y
CONFIG_I2C=y
CONFIG_SENSOR=y
CONFIG_SPI=y
CONFIG_TI_HDC=y

CONFIG_PRINTK=y
CONFIG_SERIAL=y
CONFIG_CONSOLE=y
CONFIG_STDOUT_CONSOLE=y

CONFIG_SSD16XX=y

CONFIG_HEAP_MEM_POOL_SIZE=16384

CONFIG_DISPLAY=y

CONFIG_LOG=y

CONFIG_CFB_LOG_LEVEL_DBG=y
CONFIG_CHARACTER_FRAMEBUFFER=y
```

## src/main.c
```c
/*
 * Copyright (c) 2012-2014 Wind River Systems, Inc.
 *
 * SPDX-License-Identifier: Apache-2.0
 */

#include <zephyr.h>
#include <string.h>
#include <sys/printk.h>
#include <stdio.h>
#include "hdc1010.h"
#include "display.h"

#define SLEEP_TIME_MS   1000

void main(void)
{
	int err;
	int temp[2];
	int humidity;
	//char* displayVal = "T: 28.3 C   RH: 36%";

	err=hdc1010Init();
	if(err!=0)
	{
		printk("hdc1010 init failed");
		return;
	}
	err=displayInit();
	if(err!=0)
	{
		printk("display init failed");
		return;
	}
	while(1)
	{
		err=getData(&temp, &humidity);
		if(err!=0)
		{
			printk("get data failed!");
		}
		char displayVal[] = "T:   .  C   RH:   %";
		displayVal[3] = temp[0]/10 + '0';
		displayVal[4] = temp[0]%10 + '0';;
		displayVal[6] = temp[1] + '0';;
		displayVal[16] = humidity/10 + '0';;
		displayVal[17] = humidity%10 + '0';;
		//printk("%s\n",displayVal);
		err=displayShow(displayVal);
		if(err!=0)
		{
			printk("show data failed!");
		}
		k_msleep(SLEEP_TIME_MS);
	}

}
```

## src/display.c
```c
#include <zephyr.h>
#include <device.h>
#include <display/cfb.h>
#include <stdio.h>
#include "display.h"

const struct device *dev;
uint16_t rows;
uint8_t ppt;
uint8_t font_width;
uint8_t font_height;

int displayInit(void)
{
	dev = device_get_binding(DISPLAY_DRIVER);

        if (dev == NULL) {
                printf("Device not found\n");
                return -1;
        }

        if (display_set_pixel_format(dev, PIXEL_FORMAT_MONO10) != 0) {
                printf("Failed to set required pixel format\n");
                return -1;
        }

        printf("initialized %s\n", DISPLAY_DRIVER);

        if (cfb_framebuffer_init(dev)) {
                printf("Framebuffer initialization failed!\n");
                return -1;
        }

        cfb_framebuffer_clear(dev, true);

        display_blanking_off(dev);

        rows = cfb_get_display_parameter(dev, CFB_DISPLAY_ROWS);
        ppt = cfb_get_display_parameter(dev, CFB_DISPLAY_PPT);

        for (int idx = 0; idx < 42; idx++) {
                if (cfb_get_font_size(dev, idx, &font_width, &font_height)) {
                        break;
                }
                cfb_framebuffer_set_font(dev, idx);
                printf("font width %d, font height %d\n",
                       font_width, font_height);
        }

        printf("x_res %d, y_res %d, ppt %d, rows %d, cols %d\n",
               cfb_get_display_parameter(dev, CFB_DISPLAY_WIDTH),
               cfb_get_display_parameter(dev, CFB_DISPLAY_HEIGH),
               ppt,
               rows,
               cfb_get_display_parameter(dev, CFB_DISPLAY_COLS));
	return 0;
}

int displayShow(char val[])
{
	cfb_framebuffer_clear(dev, false);
	if (cfb_print(dev,val,0, ppt)) {
		printf("Failed to print a string\n");
		return -1;
	}
	cfb_framebuffer_finalize(dev);
	return 0;
}
```

## src/display.h
```c
#if defined(CONFIG_SSD16XX)
#define DISPLAY_DRIVER          "SSD16XX"
#endif

#if defined(CONFIG_SSD1306)
#define DISPLAY_DRIVER          "SSD1306"
#endif

#ifndef DISPLAY_DRIVER
#define DISPLAY_DRIVER          "DISPLAY"
#endif

int displayInit(void);
int displayShow(char val[]);
```

## src/hdc1010.c
```c
#include <zephyr.h>
#include <string.h>
#include <soc.h>
#include <device.h>
#include <drivers/gpio.h>
#include <drivers/sensor.h>
#include <sys/printk.h>
#include "hdc1010.h"

static struct device *hdc1010_dev;


int get_hdc1010_val(struct sensor_value *val)
{
	if (sensor_sample_fetch(hdc1010_dev)) {
		printk("Failed to fetch sample for device %s\n",
		       DT_LABEL(DT_INST(0, ti_hdc1010)));
		return -1;
	}

	if (sensor_channel_get(hdc1010_dev,
			       SENSOR_CHAN_AMBIENT_TEMP,
			       &val[0])) {
		return -1;
	}

	if (sensor_channel_get(hdc1010_dev,
			       SENSOR_CHAN_HUMIDITY,
			       &val[1])) {
		return -1;
	}

	return 0;
}

int hdc1010Init(void)
{
	struct sensor_value hdc1010_val[2];
	hdc1010_dev = device_get_binding(DT_LABEL(DT_INST(0, ti_hdc1010)));
	if (hdc1010_dev == NULL) {
		printk("Failed to get %s device\n", DT_LABEL(DT_INST(0, ti_hdc1010)));
		return -1;
	}

	if (get_hdc1010_val(hdc1010_val)) {
		printk("Failed to fetch T|RH value\n");
		return -1;
	}
	return 0;

}

int getData(int (*temp)[2], int *humidity)
{
	struct sensor_value hdc1010_val[2];
	int err;
	err=get_hdc1010_val(hdc1010_val);
	if(err!=0){
		return -1;
	}
	if (!get_hdc1010_val(hdc1010_val)) {
		*(*temp + 0) = hdc1010_val[0].val1;
		//temp++;
		*(*temp + 1) = hdc1010_val[0].val2/100000;
		*humidity = hdc1010_val[1].val1;
		printk("T: %d.%d C | RH: %d%%\n",
		       hdc1010_val[0].val1,
		       hdc1010_val[0].val2/100000,
		       hdc1010_val[1].val1);
	} else {
		printk("Failed to fetch T|RH values\n");
		return -1;
	}
	return 0;
}
```

## src/hdc1010.h
```c
int get_hdc1010_val(struct sensor_value *val);
int hdc1010Init(void);
int getData(int (*temp)[2], int *humidity);
```
